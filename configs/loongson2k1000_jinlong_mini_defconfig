## configs/loongson2k500_rt_defconfig
```kconfig
BR2_loongarch64=y
BR2_TOOLCHAIN_EXTERNAL=y
BR2_TOOLCHAIN_EXTERNAL_PATH="/opt/toolchain-loongarch64-linux-gnu-gcc8-host-x86_64-2022-07-18"
BR2_TOOLCHAIN_EXTERNAL_CUSTOM_PREFIX="$(ARCH)-linux-gnu"
BR2_TOOLCHAIN_EXTERNAL_GCC_8=y
BR2_TOOLCHAIN_EXTERNAL_HEADERS_4_19=y
BR2_TOOLCHAIN_EXTERNAL_CUSTOM_GLIBC=y
BR2_TOOLCHAIN_EXTERNAL_CXX=y
BR2_TARGET_GENERIC_HOSTNAME="LS-GD"
BR2_TARGET_GENERIC_ISSUE="Welcome to Loongson-gd ramdisk"
BR2_TARGET_GENERIC_PASSWD_SHA512=y
BR2_ROOTFS_MERGED_USR=y
BR2_TARGET_GENERIC_ROOT_PASSWD="123"
BR2_TARGET_GENERIC_GETTY_PORT="ttyS2"
BR2_SYSTEM_DEFAULT_PATH="/bin:/sbin:/usr/bin:/usr/sbin"
# BR2_ENABLE_LOCALE_PURGE is not set
BR2_ROOTFS_OVERLAY="board/loongson/ls2k500/rootfs_rt_overlay"
BR2_PACKAGE_BUSYBOX_SHOW_OTHERS=y
BR2_PACKAGE_IOZONE=y
BR2_PACKAGE_NETPERF=y
BR2_PACKAGE_PV=y
BR2_PACKAGE_STRESS=y
BR2_PACKAGE_E2FSPROGS=y
BR2_PACKAGE_LIBSSH=y
BR2_PACKAGE_LIBSSH_SERVER=y
BR2_PACKAGE_LIBSOCKETCAN=y
BR2_PACKAGE_BOOST=y
BR2_PACKAGE_BOOST_VERSION_1_67=y
BR2_PACKAGE_BOOST_CONTRACT=y
BR2_PACKAGE_BOOST_EXCEPTION=y
BR2_PACKAGE_BOOST_GRAPH=y
BR2_PACKAGE_BOOST_GRAPH_PARALLEL=y
BR2_PACKAGE_BOOST_IOSTREAMS=y
BR2_PACKAGE_BOOST_JSON=y
BR2_PACKAGE_BOOST_LOCALE=y
BR2_PACKAGE_BOOST_LOG=y
BR2_PACKAGE_BOOST_MATH=y
BR2_PACKAGE_BOOST_MPI=y
BR2_PACKAGE_BOOST_NOWIDE=y
BR2_PACKAGE_BOOST_PROGRAM_OPTIONS=y
BR2_PACKAGE_BOOST_RANDOM=y
BR2_PACKAGE_BOOST_SERIALIZATION=y
BR2_PACKAGE_BOOST_STACKTRACE=y
BR2_PACKAGE_BOOST_TEST=y
BR2_PACKAGE_BOOST_TYPE_ERASURE=y
BR2_PACKAGE_BOOST_WAVE=y
BR2_PACKAGE_PENGUTRONIX_CAN_UTILS=y
BR2_PACKAGE_ETHTOOL=y
# BR2_PACKAGE_IFUPDOWN_SCRIPTS is not set
BR2_PACKAGE_IPROUTE2=y
BR2_PACKAGE_OPENSSH=y
BR2_PACKAGE_RSYNC=y
# BR2_PACKAGE_URANDOM_SCRIPTS is not set
BR2_PACKAGE_BASH=y
BR2_PACKAGE_UTIL_LINUX_LIBFDISK=y
BR2_PACKAGE_UTIL_LINUX_LIBSMARTCOLS=y
BR2_PACKAGE_UTIL_LINUX_FSCK=y
BR2_PACKAGE_UTIL_LINUX_MOUNT=y
# BR2_PACKAGE_LS2_SYS_CONFIG_TOOL is not set
BR2_TARGET_ROOTFS_TAR_GZIP=y
BR2_TARGET_ROOTFS_UBI=y
BR2_TARGET_ROOTFS_UBI_SUBSIZE=2048
BR2_TARGET_ROOTFS_UBI_USE_CUSTOM_CONFIG=y
BR2_TARGET_ROOTFS_UBI_CUSTOM_CONFIG_FILE="board/loongson/ubinize.cfg"
BR2_TARGET_ROOTFS_UBIFS_LEBSIZE=0x1f000
BR2_TARGET_ROOTFS_UBIFS_MAXLEBCNT=1900
BR2_PACKAGE_HOST_E2FSPROGS=y
BR2_PACKAGE_HOST_GENIMAGE=y
```

## configs/ls1b20_mini_busybox_gcc4.9_defconfig
```kconfig
BR2_mipsel=y
BR2_TOOLCHAIN_EXTERNAL=y
BR2_TOOLCHAIN_EXTERNAL_PATH="/opt/buildroot-2016.02-glibc-gcc-4.9.x-mips32-nofpu/output/host/usr/"
BR2_TOOLCHAIN_EXTERNAL_GCC_4_9=y
BR2_TOOLCHAIN_EXTERNAL_HEADERS_3_18=y
BR2_TOOLCHAIN_EXTERNAL_CUSTOM_GLIBC=y
BR2_TOOLCHAIN_EXTERNAL_CXX=y
BR2_TARGET_GENERIC_HOSTNAME="huolong"
BR2_TARGET_GENERIC_ISSUE="Welcome to Buildroot for the LS1B20-HuoLong"
BR2_TARGET_GENERIC_PASSWD_SHA512=y
BR2_ROOTFS_MERGED_USR=y
BR2_TARGET_GENERIC_ROOT_PASSWD="loongson"
BR2_TARGET_GENERIC_GETTY_PORT="ttyS5"
BR2_SYSTEM_DEFAULT_PATH="/bin:/sbin:/usr/bin:/usr/sbin"
# BR2_ENABLE_LOCALE_PURGE is not set
BR2_ROOTFS_OVERLAY="board/loongson/ls1b20-huolong/rootfs_4_7_gcc_overlay"
BR2_PACKAGE_DIRECTFB=y
BR2_PACKAGE_DBUS=y
BR2_PACKAGE_RTC_TOOLS=y
BR2_PACKAGE_SQLITE=y
BR2_PACKAGE_SQLITE_STAT4=y
BR2_PACKAGE_SQLITE_ENABLE_COLUMN_METADATA=y
BR2_PACKAGE_SQLITE_ENABLE_FTS3=y
BR2_PACKAGE_SQLITE_ENABLE_JSON1=y
BR2_PACKAGE_SQLITE_ENABLE_UNLOCK_NOTIFY=y
BR2_PACKAGE_SQLITE_SECURE_DELETE=y
BR2_PACKAGE_SQLITE_NO_SYNC=y
BR2_PACKAGE_PCRE2=y
BR2_PACKAGE_PCRE2_16=y
BR2_PACKAGE_CAN_UTILS=y
BR2_PACKAGE_ETHTOOL=y
BR2_PACKAGE_IFTOP=y
BR2_PACKAGE_IPROUTE2=y
# BR2_PACKAGE_URANDOM_SCRIPTS is not set
BR2_PACKAGE_UTIL_LINUX_BINARIES=y
BR2_PACKAGE_UTIL_LINUX_AGETTY=y
BR2_PACKAGE_UTIL_LINUX_FSCK=y
BR2_PACKAGE_UTIL_LINUX_MOUNT=y
BR2_PACKAGE_UTIL_LINUX_NOLOGIN=y
BR2_TARGET_ROOTFS_TAR_GZIP=y
BR2_TARGET_ROOTFS_UBI=y
BR2_TARGET_ROOTFS_UBI_SUBSIZE=2048
BR2_TARGET_ROOTFS_UBI_USE_CUSTOM_CONFIG=y
BR2_TARGET_ROOTFS_UBI_CUSTOM_CONFIG_FILE="board/loongson/ubinize-128m.cfg"
BR2_TARGET_ROOTFS_UBIFS_LEBSIZE=0x1f000
BR2_TARGET_ROOTFS_UBIFS_MAXLEBCNT=1600
BR2_PACKAGE_HOST_CMAKE=y
BR2_PACKAGE_HOST_DOSFSTOOLS=y
BR2_PACKAGE_HOST_E2FSPROGS=y
BR2_PACKAGE_HOST_GENIMAGE=y
BR2_PACKAGE_HOST_MTOOLS=y
```

## package/autoreboot/Config.in
```kconfig
config BR2_PACKAGE_AUTOREBOOT
	bool "loongson buildroot system autoreboot test"
	depends on BR2_INIT_SYSTEMD || BR2_INIT_BUSYBOX
	help
		this will create a service which name is autoboot.service
		and create a script in /opt which name is autoreboot.sh
		so this service will run this script after system reboot.
		when the script start run it'll make /opt/log_autoreboot for store log 
		which to record the count of reboot and reboot time. the default reboot
		times is 1000.
		if you don't need it you can run this command
		'systemctl disable autoreboot'
		if you want to enable this service you can run this command
		'systemctl enable autoreboot'
```

## package/dhcpcd5/Config.in
```kconfig
comment "dhcpcd needs a toolchain w/ headers >= 3.1"
	depends on !BR2_TOOLCHAIN_HEADERS_AT_LEAST_3_1

config BR2_PACKAGE_DHCPCD5
	bool "dhcpcd5"
	depends on BR2_TOOLCHAIN_HEADERS_AT_LEAST_3_1 # sa_family_t in linux/socket.h
	help
	  DHCP5 client
```

## package/fastboot_busybox/Config.in
```kconfig
config BR2_PACKAGE_FASTBOOT_BUSYBOX
	bool "loongson buildroot system fastboot setup about busybox init process"
	depends on BR2_INIT_BUSYBOX
	default n
	help
		systemd start need long time but busybox start be faster.
		but some sofeware need start service which define in /etc/init.d/S* file
		this service will need some time to boot.
		so when this option selected,it will move /etc/init.d all S* file
		to /root/init.d-bak so that delelte this service boot
```

## package/git_info_lsgd/Config.in
```kconfig
config BR2_PACKAGE_GIT_INFO_LSGD
	bool "generate git info in rootfs"
	default y
	help
		this is a function about loongson-gd
		if select this function
		it will generate a file which name is git_info_ls
		this file will record git info last commit
		content is git commit id time and message
		and you can use
		fs_git_info_lsgd
		command when rootfs run
		and you can see this file content
		file save in /etc in rootfs
```

## package/libelectric-fence/Config.in
```kconfig
config BR2_PACKAGE_LIBELECTRIC_FENCE
	bool "electric fence"
	help
		2.2.6version from debian.
		just work for -lefence
```

## package/libgo_la/Config.in
```kconfig
config BR2_PACKAGE_LIBGO_LA
	bool "loongarch libgo temp version"
	help
		this libgo version not use thrid-party boost context
		just add loongarch asm about jump make context code
```

## package/ls-modload/Config.in
```kconfig
config BR2_PACKAGE_LS_MODLOAD
	bool "loongson buildroot system auto load module"
	depends on BR2_INIT_BUSYBOX
	help
		this will do modprobe in /etc/init.d script

config BR2_PACKAGE_LS_MODLOAD_ALL
	bool "auto load all modules"
	depends on BR2_PACKAGE_LS_MODLOAD
	help
		this will do modprobe all modules in /lib/modules/`uname -r`/modules.dep,
		if BR2_PACKAGE_LS_LOADMODULE_ALL not set, modprobe will load modules
		in /etc/modules

config BR2_PACKAGE_LS_MODLOAD_DELAY
	bool "modules load delay 5s after boot"
	depends on BR2_PACKAGE_LS_MODLOAD
	default n
	help
		if run a process after boot and need fast
		can delay load module
```

## package/ls-usb-mount/Config.in
```kconfig
config BR2_PACKAGE_LS_USB_MOUNT
	bool "loongson buildroot system auto mount usb in busybox"
	depends on BR2_INIT_BUSYBOX
	default n
	help
		just for init process as busybox to auto mount busybox

config BR2_PACKAGE_LS_USB_MOUNT_DELAY
	bool "modules load delay 5s after boot"
	depends on BR2_PACKAGE_LS_USB_MOUNT
	default n
	help
		if run a process after boot and need fast
		can delay load module
```

## package/lvgl_kit/Config.in
```kconfig
config BR2_PACKAGE_LVGL_KIT
	bool "lvgl demo sofeware"
	select BR2_PACKAGE_LIBDRM
	select BR2_PACKAGE_LIBXKBCOMMON
	help
		lvgl v8.2 demo sofeware transplant by loongson(GD).
		just use libxkbcommon and libdrm.
		work in linux + rootfs(which not X).
		it just a demo sofeware not any func in this sofeware.
		you can input lvgl_demo in shell to work it.

config BR2_PACKAGE_TOUCH_SCREEN_MAP_VALUE
	bool "touch screen xy map logic enable"
	default n
	depends on BR2_PACKAGE_LVGL_KIT
	help
		if board use screen report the xy value bigger than screen pixel.
		may be you need check this property.
		and write down the max report value in BR2_PACKAGE_TOUCH_SCREEN_MAP_VALUE_X(Y).
		and it will create file which path is /etc/lvgl_config.
		and file have two property
		abs_x_calu_max=xxx
		abs_y_calu_max=xxx
		xxx from BR2_PACKAGE_TOUCH_SCREEN_MAP_VALUE_X(Y)
		e.g.
		abs_x_calu_max=16384
		abs_y_calu_max=16384
		if touch screen report value is one to one screen pixel you need check this property.

config BR2_PACKAGE_TOUCH_SCREEN_MAP_VALUE_X
	string "touch screen x map max value"
	default "16384"
	depends on BR2_PACKAGE_TOUCH_SCREEN_MAP_VALUE
	help
		this property is touch screen report x max value

config BR2_PACKAGE_TOUCH_SCREEN_MAP_VALUE_Y
	string "touch screen y map max value"
	default "16384"
	depends on BR2_PACKAGE_TOUCH_SCREEN_MAP_VALUE
	help
		this property is touch screen report y max value
```

## package/minigui5/Config.in
```kconfig
config BR2_PACKAGE_MINIGUI5
	bool "MINIGUI"
	depends on BR2_TOOLCHAIN_HAS_THREADS_NPTL
	depends on BR2_TOOLCHAIN_GCC_AT_LEAST_4_9 # C++11, GCC_BUG_57694
	depends on !BR2_STATIC_LIBS
	depends on BR2_mips64el || BR2_mipsel || BR2_loongarch64
	select BR2_PACKAGE_ICU
	select BR2_PACKAGE_ZLIB
	select BR2_PACKAGE_JPEG
	select BR2_PACKAGE_LIBPNG
	select BR2_PACKAGE_FREETYPE
	select BR2_PACKAGE_HARFBUZZ
	select BR2_PACKAGE_LIBDRM
	select BR2_PACKAGE_MTDEV
	select BR2_PACKAGE_KMOD
	select BR2_PACKAGE_UTIL_LINUX
	select BR2_PACKAGE_UTIL_LINUX_LIBBLKID
	select BR2_PACKAGE_HAS_UDEV
	select BR2_PACKAGE_LIBEVDEV
	select BR2_PACKAGE_LIBINPUT
	select BR2_PACKAGE_SQLITE
	select BR2_PACKAGE_SQLITE_STAT4
	select BR2_PACKAGE_SQLITE_ENABLE_COLUMN_METADATA
	select BR2_PACKAGE_SQLITE_ENABLE_FTS3
	select BR2_PACKAGE_SQLITE_ENABLE_JSON1
	select BR2_PACKAGE_SQLITE_ENABLE_UNLOCK_NOTIFY
	select BR2_PACKAGE_SQLITE_SECURE_DELETE
	select BR2_PACKAGE_SQLITE_NO_SYNC
	select BR2_PACKAGE_LIBELECTRIC_FENCE
	select BR2_PACKAGE_PIXMAN
	help
	  This option enables the minigui5 framework.
	  this lib will install whitout compiler
	  now will support mipsel mips64el and LA64
	  it will disable chipmunk by buildroot which version is 7.0.2
	  and use chipmunk 5.3.2 to overlay rootfs
```

## package/pengutronix-can-utils/Config.in
```kconfig
config BR2_PACKAGE_PENGUTRONIX_CAN_UTILS
	bool "pengutronix can-utils"
	depends on BR2_USE_MMU # fork()
	depends on BR2_PACKAGE_LIBSOCKETCAN
	help
	  SocketCAN is a set of open source CAN drivers and a
	  networking stack.
	  This package based on Pengutronix code.

	  https://github.com/jmore-reachtech/can-utils
```
